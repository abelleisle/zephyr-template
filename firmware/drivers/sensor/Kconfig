## firmware/drivers/sensor/soil_moisture/Kconfig
```kconfig
# Soil Moister Sensor v1.2

menuconfig SOIL_MOISTURE
	bool "Soil Moisture Sensor v1.2"
	depends on ADC
	help
	  Enable driver for Soil Moisture Sensor v1.2

if SOIL_MOISTURE

config SOIL_THREAD_PRIORITY
	int "Thread priority"
	default 10
	help
	  Priority of thread used by the driver to handle interrupts.

config SOIL_THREAD_STACK_SIZE
	int "Thread stack size"
	default 1024
	help
	  Stack size of thread used by the driver to handle interrupts.

endif # SOIL_MOISTURE
```
