## CMakeLists.txt
```
# SPDX-License-Identifier: Apache-2.0

cmake_minimum_required(VERSION 3.20.0)

find_package(Zephyr REQUIRED HINTS $ENV{ZEPHYR_BASE})
project(wifi)

add_subdirectory(lib)
add_subdirectory(drivers)

set(CMAKE_VERBOSE_MAKEFILE on)

FILE(GLOB app_sources src/*.cpp)

target_sources(app
    PRIVATE
        ${app_sources}
    )

target_link_libraries(app PUBLIC protos)
```

## Kconfig
```
# SPDX-License-Identifier: Apache-2.0

mainmenu "Smart Plant"

# Your application configuration options go here

# Sources Kconfig.zephyr in the Zephyr root directory.
#
# Note: All 'source' statements work relative to the Zephyr root directory (due
# to the $srctree environment variable being set to $ZEPHYR_BASE). If you want
# to 'source' relative to the current Kconfig file instead, use 'rsource' (or a
# path relative to the Zephyr root).
source "Kconfig.zephyr"
rsource "drivers/Kconfig"
```

## west.yml
```
# Copyright (c) 2022 Andy Belle-Isle

manifest:
  self:
    path: firmware

  remotes:
    - name: zephyrproject-rtos
      url-base: https://github.com/zephyrproject-rtos
    - name: etlcpp
      url-base: https://github.com/ETLCPP

  projects:
    - name: zephyr
      remote: zephyrproject-rtos
      revision: v3.2-branch
      import:
        path-prefix: os
    - name: etl
      remote: etlcpp
      revision: d63be881a44879a3e17aa263368d5571823afba1
      path: firmware/lib/etl
```

## prj.conf
```kconfig
CONFIG_EARLY_CONSOLE=y

CONFIG_NETWORKING=y
#CONFIG_TEST_RANDOM_GENERATOR=y

CONFIG_NET_TX_STACK_SIZE=2048
CONFIG_NET_RX_STACK_SIZE=2048

CONFIG_NET_PKT_RX_COUNT=10
CONFIG_NET_PKT_TX_COUNT=10
CONFIG_NET_BUF_RX_COUNT=20
CONFIG_NET_BUF_TX_COUNT=20
CONFIG_NET_MAX_CONTEXTS=10
CONFIG_NET_DHCPV4=y

CONFIG_NET_IPV4=y
CONFIG_NET_IPV6=n

CONFIG_NET_TCP=y

CONFIG_NET_LOG=y
CONFIG_INIT_STACKS=y

CONFIG_NET_SHELL=y

CONFIG_NET_STATISTICS=y
CONFIG_NET_STATISTICS_PERIODIC_OUTPUT=n

CONFIG_WIFI=y
CONFIG_WIFI_LOG_LEVEL_ERR=y
CONFIG_NET_L2_WIFI_SHELL=y

CONFIG_NANOPB=y
```

## dts/bindings/bindings/soil,soil_moisture.yaml
```yaml
description: Soil Moisture Sensor

# Soil Moisture is ADC
compatible: "soil,soil_moisture"

include: [sensor-device.yaml, adc-controller.yaml]

properties:
  io-channels:
    required: true
    description: ADC channel for soil moisture sensor
```

## src/wifi_test.cpp
```c
/*
 * Copyright (c) 2016 Intel Corporation.
 *
 * SPDX-License-Identifier: Apache-2.0
 */

#include <zephyr/kernel.h>
#include <errno.h>

#include <stdint.h>
#include <zephyr/sys/cbprintf.h>

#include <pb_encode.h>
#include <pb_decode.h>
#include <messages.pb.h>

int main(void)
{
    messages_Person person = messages_Person_init_zero;

    uint8_t buffer[128];
    size_t message_length;
    bool status;

    /* Encode the messages */
    {
        messages_Person person = messages_Person_init_zero;

        /* Create a stream that will write to our buffer. */
        pb_ostream_t stream = pb_ostream_from_buffer(buffer, sizeof(buffer));

        /* Fill in the lucky number */
        person.id = 1234;

        /* Now we are ready to encode the message! */
        status = pb_encode(&stream, messages_Person_fields, &person);
        message_length = stream.bytes_written;

        /* Then just check for any errors.. */
        if (!status)
        {
            printk("Encoding failed: %s\n", PB_GET_ERROR(&stream));
            return 1;
        }
    }

    /* Decode message */
    {
        /* Allocate space for the decoded message. */
        messages_Person person = messages_Person_init_zero;

        /* Create a stream that reads from the buffer. */
        pb_istream_t stream = pb_istream_from_buffer(buffer, message_length);

        /* Now we are ready to decode the message. */
        status = pb_decode(&stream, messages_Person_fields, &person);

        /* Check for errors... */
        if (!status)
        {
            printk("Decoding failed: %s\n", PB_GET_ERROR(&stream));
            return 1;
        }

        /* Print the data contained in the message. */
        printk("Person ID: %d!\n", person.id);
    }

    return 0;
}
```
